// SPDX-License-Identifier: GPL-2.0-or-later
/*
 * Realtek RTL9607C engineering board (bring-up placeholder).
 *
 * Generic board on top of the RTL9607C SoC for M1 run-from-RAM bring-up:
 * serial console + initramfs only. A real board profile (panel LEDs/keys,
 * Ethernet/PHY, GPON optics, flash layout) replaces this once the board is
 * mapped.
 */

/dts-v1/;

#include "rtl9607c.dtsi"

/ {
	model = "Realtek RTL9607C (engineering board)";
	compatible = "realtek,rtl9607c-engboard", "realtek,rtl9607c", "rtk,8198d";

	aliases {
		serial0 = &uart0;
	};

	chosen {
		stdout-path = "serial0:115200n8";
		/* bootargs: see luna.dtsi -- the command line is FAMILY
		 * configuration, and this board spelled its own until
		 * 2026-08-27.  The two boards disagreed and only one could be
		 * debugged: without ignore_loglevel this kernel prints nothing
		 * between "Starting kernel" and userspace. */
	};
};
