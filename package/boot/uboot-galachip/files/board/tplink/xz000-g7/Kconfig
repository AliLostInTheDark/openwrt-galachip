## package/boot/uboot-galachip/files/board/tplink/xz000-g7/Kconfig
```kconfig
if ARCH_GALACHIP
config SYS_BOARD
	default "xz000-g7"
config SYS_VENDOR
	default "tplink"
config SYS_CONFIG_NAME
	default "xz000_g7"
endif
```

## package/boot/uboot-galachip/files/configs/xz000_g7_defconfig
```kconfig
CONFIG_ARM=y
CONFIG_ARCH_GALACHIP=y
CONFIG_TEXT_BASE=0x40010000
CONFIG_CUSTOM_SYS_INIT_SP_ADDR=0x40f00000
CONFIG_HAS_CUSTOM_SYS_INIT_SP_ADDR=y
CONFIG_SYS_MALLOC_LEN=0x100000
CONFIG_SYS_MALLOC_F_LEN=0x4000
CONFIG_NR_DRAM_BANKS=1
CONFIG_DEFAULT_DEVICE_TREE="gc1601-tplink-xz000-g7"
CONFIG_SYS_LOAD_ADDR=0x41000000
CONFIG_SYS_ICACHE_OFF=y
CONFIG_SYS_DCACHE_OFF=y
CONFIG_SYS_ARM_CACHE_CP15=y
# CONFIG_SYS_ARM_MMU is not set
# CONFIG_SYS_THUMB_BUILD is not set
CONFIG_BOOTDELAY=3
CONFIG_USE_BOOTCOMMAND=y
CONFIG_BOOTCOMMAND="g7boot"
CONFIG_SYS_PROMPT="G7> "
CONFIG_SYS_CBSIZE=512
CONFIG_SYS_PBSIZE=544
CONFIG_MISC_INIT_R=y
CONFIG_OF_BOARD_SETUP=y
CONFIG_ENV_IS_NOWHERE=y
CONFIG_ENV_SIZE=0x2000
# CONFIG_CMD_SAVEENV is not set
# CONFIG_CMD_IMPORTENV is not set
# CONFIG_CMD_EXPORTENV is not set
# CONFIG_ENV_VARS_UBOOT_RUNTIME_CONFIG is not set
CONFIG_CMD_BDI=y
CONFIG_CMD_CRC32=y
CONFIG_CMD_BOOTZ=y
CONFIG_CMD_FDT=y
CONFIG_CMD_SF=y
CONFIG_CMD_PING=y
CONFIG_CMD_SLEEP=y
CONFIG_CMD_TFTPPUT=n
CONFIG_CMD_MEMORY=y
# CONFIG_CMD_MEMTEST is not set
# CONFIG_CMD_FLASH is not set
# CONFIG_CMD_FPGA is not set
# CONFIG_CMD_NFS is not set
# CONFIG_CMD_SOURCE is not set
# CONFIG_CMD_SETEXPR is not set
# CONFIG_CMD_BOOTEFI is not set
# CONFIG_BOOTSTD is not set
# CONFIG_EFI_LOADER is not set
# CONFIG_CMD_BOOTM is not set
# CONFIG_FIT is not set
# CONFIG_GZIP is not set
# CONFIG_VIDEO is not set
# CONFIG_USB is not set
# CONFIG_MMC is not set
# CONFIG_SCSI is not set
# CONFIG_NET_RANDOM_ETHADDR is not set
CONFIG_NET=y
CONFIG_NETDEVICES=y
CONFIG_DM_ETH=y
CONFIG_DM_MDIO=y
CONFIG_DM_ETH_PHY=y
CONFIG_PHYLIB=y
CONFIG_PHY_GIGE=y
CONFIG_MTD=y
CONFIG_SPI_FLASH=y
CONFIG_SPI=y
CONFIG_DM_SPI=y
CONFIG_SPI_MEM=y
CONFIG_DM_SPI_FLASH=y
CONFIG_SPI_FLASH_EON=y
# CONFIG_SPI_FLASH_SFDP_SUPPORT is not set
# CONFIG_SPI_FLASH_SMART_HWCAPS is not set
CONFIG_CLK=y
CONFIG_TIMER=y
CONFIG_DM_SERIAL=y
CONFIG_SYS_NS16550=y
CONFIG_SYS_NS16550_MEM32=y
CONFIG_BAUDRATE=115200
CONFIG_OF_SEPARATE=y
CONFIG_LMB=y
CONFIG_USE_PRIVATE_LIBGCC=y
# CONFIG_LOCALVERSION_AUTO is not set
# CONFIG_DISTRO_DEFAULTS is not set
# CONFIG_DISPLAY_CPUINFO is not set
# CONFIG_CMD_ELF is not set
# CONFIG_BOOTM_NETBSD is not set
# CONFIG_BOOTM_OPENRTOS is not set
# CONFIG_BOOTM_OSE is not set
# CONFIG_BOOTM_PLAN9 is not set
# CONFIG_BOOTM_RTEMS is not set
# CONFIG_BOOTM_VXWORKS is not set
# CONFIG_BOOTM_QNX is not set
CONFIG_CMD_LOADB=y
CONFIG_CMD_LOADXY_TIMEOUT=30
# CONFIG_SPI_FLASH_UNLOCK_ALL is not set
# CONFIG_SPI_FLASH_LOCK is not set
# CONFIG_SPI_FLASH_USE_4K_SECTORS is not set
CONFIG_SF_DEFAULT_SPEED=25000000
# CONFIG_CMD_LOADS is not set
CONFIG_NET_RETRY_COUNT=5
CONFIG_TFTP_BLOCKSIZE=1468
CONFIG_TFTP_WINDOWSIZE=1
```

## target/linux/galachip/files/arch/arm/mach-galachip/Kconfig
```kconfig
# SPDX-License-Identifier: GPL-2.0-only
config ARCH_GALACHIP
	bool "GalaChip GC1601A support"
	depends on ARCH_MULTI_V5
	depends on CPU_LITTLE_ENDIAN && !CPU_FA526
	select CPU_FA626TE
	select COMMON_CLK_GC1601
	select FARADAY_FTINTC030
	select GC1601_TIMER
	help
	  Support for GalaChip GC1601A platforms using the Faraday FA626TE.
	  This enables the RAM, serial console, interrupt and timer foundation.
```

## target/linux/galachip/files/drivers/net/ethernet/galachip/Kconfig
```kconfig
# SPDX-License-Identifier: GPL-2.0-only
config NET_VENDOR_GALACHIP
	bool "GalaChip devices"
	default y
	depends on ARCH_GALACHIP || COMPILE_TEST
	help
	  If you have a network (Ethernet) device belonging to this class, say Y.

if NET_VENDOR_GALACHIP

config GC1601_ETH
	bool "GalaChip GC1601 experimental Ethernet support"
	depends on ARCH_GALACHIP || COMPILE_TEST
	depends on OF && HAS_IOMEM && HAS_DMA
	select PHYLIB
	select MDIO_GC1601
	help
	  This driver supports the GMAC and Packet Management Unit (PMU)
	  Ethernet controller found in GalaChip GC1601 SoCs.
	  Published DMA memory is retained until power-cycle because hardware
	  drain/reset is not yet established. Interface reopening is unsupported.

endif # NET_VENDOR_GALACHIP
```

## target/linux/galachip/files/drivers/soc/galachip/Kconfig
```kconfig
# SPDX-License-Identifier: GPL-2.0-only
config GC1601_PACKET_DIAG
	bool "GC1601 packet-engine diagnostics"
	depends on ARCH_GALACHIP || COMPILE_TEST
	depends on OF && HAS_IOMEM
	help
	  Expose selected packet-engine configuration registers through sysfs
	  for GC1601 bring-up. Completion reads require an explicit sysfs
	  trigger with MAC/RX disabled and no pending RX or scheduler-ready
	  bits. This does not enable DMA or reset the shared xPON hardware.

config GC1601_PACKET_DMA_TEST
	bool "GC1601 packet DMA allocation test"
	depends on GC1601_PACKET_DIAG
	help
	  Test Linux-owned coherent packet buffers and descriptor storage at
	  probe time, then free them without programming hardware addresses.
	  This does not test device DMA or enable Ethernet packet transfer.

config GC1601_PACKET_SRAM_TEST
	bool "GC1601 guarded SRAM initialization test"
	depends on GC1601_PACKET_DIAG && !GC1601_PACKET_DMA_TEST
	help
	  Permit one explicit PM/OS SRAM initialization attempt per boot,
	  with ingress disabled and no pending RX or scheduler-ready bits.
	  This changes allocator state, but does not publish DMA pointers,
	  enable traffic or reset shared xPON hardware. Power-cycle afterward.

config GC1601_PACKET_TX_TEST
	bool "GC1601 one-shot inherited-pool TX test"
	depends on GC1601_PACKET_DIAG && HAS_DMA
	depends on !GC1601_PACKET_DMA_TEST && !GC1601_PACKET_SRAM_TEST
	help
	  Permit one explicitly requested TX frame using the reserved loader
	  pool and a Linux-owned descriptor ring. Enable the PMU gate and GMAC
	  during transmission, hold briefly, then restore quiescent state.
	  No shared reset or SRAM initialization is issued. DMA storage is retained even
	  after failure. Capture LAN traffic and power-cycle after the test.

config GC1601_PACKET_RX_TEST
	bool "GC1601 one-shot guarded RX test"
	depends on GC1601_PACKET_DIAG && HAS_DMA
	depends on !GC1601_PACKET_DMA_TEST && !GC1601_PACKET_SRAM_TEST
	depends on !GC1601_PACKET_TX_TEST
	help
	  Permit one explicitly requested RX packet capture using the reserved
	  loader pool and descriptor ring. Enable PMU gate and GMAC to receive
	  one frame, acknowledge the descriptor, release the buffer and return
	  to quiescent state. Power-cycle after the test.

config GC1601_PACKET_LOADER_STATE
	bool "GC1601 read-only loader state capture"
	depends on GC1601_PACKET_DIAG && ARCH_GALACHIP
	depends on !GC1601_PACKET_DMA_TEST && !GC1601_PACKET_SRAM_TEST
	depends on !GC1601_PACKET_TX_TEST && !GC1601_PACKET_RX_TEST
	help
	  Expose the reserved XZ000-G7 loader free-list through its existing
	  CPU mapping. Disable completion sampling, TX and SRAM tests.
	  Require the loader arena to remain reserved for the entire boot.
	  Reads do not establish cache coherency or idle DMA ownership.

config GC1601_PACKET_GATE_TEST
	bool "GC1601 one-shot RX-gate allocation test"
	depends on GC1601_PACKET_LOADER_STATE
	help
	  Permit one explicit allocation with the RX-engine gate enabled
	  and MAC ingress disabled. Restore the gate on every exit path.
	  Retain any allocated buffer until a power cycle; no packet is sent.
	  This changes allocator state and requires disconnected fiber.

config GC1601_PON
	tristate "GC1601 GPON/EPON MAC and PON SerDes"
	depends on ARCH_GALACHIP || COMPILE_TEST
	depends on OF && HAS_IOMEM && I2C && MTD
	depends on GC1601_ETH
	depends on XPON_OMCI
	help
	  Report PON SerDes, optical and ONU state through sysfs. Bring up
	  the PON SerDes in GPON or EPON mode, initialise the matching MAC
	  with optical RX on, program the BOSA from the hwconfig partition,
	  run GPON activation or EPON registration and provide the
	  xPON/OMCI device (pon0). Optical TX stays off until userspace
	  allows it (allow_tx).

config GC1601_GPON_DIAG
	tristate "GC1601 GPON diagnostics"
	depends on GC1601_PON
	help
	  Log the GPON activation, PLOAMs, OMCI messages, T-CONT, GEM port
	  and service set-up and the switch flows to the kernel log, for
	  bring-up on a new OLT. Read-only; load it only when asked for a
	  report.

config GC1601_EPON_DIAG
	tristate "GC1601 EPON diagnostics"
	depends on GC1601_PON
	help
	  Log EPON MAC registers, registration events and the first
	  downstream and upstream frames to the kernel log, for bring-up on
	  an EPON OLT. Read-only; load it only when asked for a report.
```

## target/linux/galachip/files/net/xpon/Kconfig
```kconfig
# SPDX-License-Identifier: GPL-2.0-only
menuconfig XPON
	tristate "xPON subsystem"
	depends on NET
	help
	  Generic Passive Optical Network subsystem. It provides the common
	  representation used by GPON, EPON and XGS-PON devices, including
	  registration state, optical state, carrier, LEDs, sysfs and Generic
	  Netlink notifications.

if XPON

config XPON_OMCI
	tristate "xPON OMCI transport"
	default y
	help
	  ONU Management and Control Interface transport for GPON and XGS-PON
	  providers: Generic Netlink ownership, session generations, typed
	  hardware requests and the identity/configuration store. The OMCI
	  protocol itself runs in userspace (omcid).

config XPON_OAM
	tristate "xPON IEEE 802.3ah OAM"
	default y
	help
	  IEEE 802.3ah Ethernet OAM support for EPON links. The initial
	  implementation provides the per-LLID OAM object and Information
	  OAMPDU wire definitions. Event, variable and vendor extensions are
	  added on top of this core.

endif # XPON
```

## target/linux/gpon-common/files-6.18/drivers/net/gpon/Kconfig
```kconfig
# SPDX-License-Identifier: GPL-2.0-only
#
# The GPON protocol core: PLOAM, OMCI, GEM and flow offload, selected by the
# Luna GPON driver.

config GPON_CORE
	bool
	help
	  The hardware-independent GPON protocol core: the PLOAM activation
	  state machine, the in-kernel G.988 OMCI responder and the GEM/T-CONT
	  provisioning lifecycle. The vendor GPON driver selects it. It is
	  built in only, as that driver is.

config OLT_ZTE
	bool "Serve ZTE OLTs"
	depends on GPON_CORE
	default y
	help
	  What only a ZTE OLT needs of the ONU: the "zte" far-end profile
	  (OMCC 0xa2, ME 138 and ME 340 on the VEIP), ZTE's vendor MEs 247
	  (extended ONU-G) and 65294 (SNTP), and PLOAM 0x81 (ZTE's
	  Disable_Serial_Number). Off, a ZTE OLT's messages are unknown to
	  this image: they land in /proc/gpon_unknown and /proc/ploam_unknown,
	  and a board declaring ME 247 or 65294 is refused at boot.

config GPON_FLOW_OFFLOAD
	bool
	depends on GPON_CORE
	help
	  The TC hardware-offload lifecycle: reading a TC rule into a 5-tuple,
	  keeping the cookie -> flow map, tearing entries down and answering
	  stats polls. The driver's accelerator backend selects it and
	  supplies the engine (struct gpon_flow_ops).

config GPON_FLOW_DIAG
	bool "GPON accelerator diagnostics (why a flow was NOT offloaded)"
	depends on GPON_FLOW_OFFLOAD
	default y
	help
	  Records why a TC flow was refused by the hardware accelerator, for
	  the flow-offload /proc nodes.

config GPON_GEM_DIAG
	bool "GPON data-path diagnostics (what the WAN path is waiting for)"
	depends on GPON_CORE
	default y
	help
	  Reports which step of the GEM/T-CONT data path is still missing
	  when no traffic passes.

config GPON_OLT_DIAG
	bool "GPON far-end capture (record the OLT's conversation for offline replay)"
	depends on GPON_CORE
	default y
	help
	  Keeps rings of the OMCI and PLOAM messages the OLT sent, readable
	  from /proc/oltcap, /proc/ploamcap, /proc/gpon_prov, /proc/gpon_unknown
	  and /proc/ploam_unknown, so an OLT's behaviour can be analysed
	  offline.

config GPON_OLT_DIAG_RECORDS
	int "Records per far-end capture ring (OMCI and PLOAM)"
	depends on GPON_OLT_DIAG
	range 16 4096
	default 256
	help
	  Messages kept per capture ring. 256 holds a full provisioning.

config GPON_OMCI_DIAG
	bool "GPON OMCI per-message diagnostics (message type, ME, Get masks)"
	depends on GPON_CORE
	default y
	help
	  Decodes each OMCI message for the OMCI trace: message type, managed
	  entity, attribute masks and values.

config GPON_PLOAM_DIAG
	bool "GPON activation diagnostics (grant acceptance at Assign/Ranging/Deactivate)"
	depends on GPON_CORE
	default y
	help
	  Counts the downstream PLOAM messages by type and reports what the
	  activation saw at Assign_ONU-ID, Ranging and Deactivate.
```
