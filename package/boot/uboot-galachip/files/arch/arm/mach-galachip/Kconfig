## package/boot/uboot-galachip/files/arch/arm/mach-galachip/Kconfig
```kconfig
if ARCH_GALACHIP

choice
	prompt "GalaChip board select"

config TARGET_TPLINK_XZ000_G7
	bool "TP-Link XZ000-G7"
	help
	  The TP-Link XZ000-G7 GPON ONT: a GC1601 with 32 MiB of DDR and
	  4 MiB of SPI NOR flash.

endchoice

config SYS_SOC
	default "galachip"

config SYS_CONFIG_NAME
	default "gc1601"

config GC1601_SPL_SPI_OFFS
	hex "Offset of the U-Boot SPL image in the SPI flash"
	depends on TPL
	default 0x2000
	help
	  The TPL loads the SPL, a legacy image, from this offset of the SPI
	  flash. The mask ROM's image for the TPL comes before it.

source "board/tplink/xz000-g7/Kconfig"

endif
```

## package/boot/uboot-galachip/files/board/tplink/xz000-g7/Kconfig
```kconfig
if TARGET_TPLINK_XZ000_G7

config SYS_BOARD
	default "xz000-g7"

config SYS_VENDOR
	default "tplink"

endif
```

## package/boot/uboot-galachip/files/configs/tplink_xz000_g7_defconfig
```kconfig
CONFIG_ARM=y
CONFIG_ARCH_GALACHIP=y
CONFIG_TARGET_TPLINK_XZ000_G7=y
CONFIG_SKIP_LOWLEVEL_INIT=y
CONFIG_SPL=y
CONFIG_TPL=y
CONFIG_TPL_TEXT_BASE=0x80000000
CONFIG_TPL_MAX_SIZE=0x1c00
CONFIG_TPL_SIZE_LIMIT=0x1c00
CONFIG_TPL_HAVE_INIT_STACK=y
CONFIG_TPL_STACK=0x80002000
CONFIG_TPL_STACK_R=y
CONFIG_TPL_STACK_R_ADDR=0x40300000
CONFIG_TPL_LDSCRIPT="arch/arm/mach-galachip/u-boot-tpl.lds"
CONFIG_TPL_SYS_THUMB_BUILD=y
CONFIG_TPL_SKIP_LOWLEVEL_INIT=y
CONFIG_TPL_SERIAL=y
CONFIG_TPL_SYS_NS16550_SERIAL=y
CONFIG_SYS_NS16550_REG_SIZE=-4
CONFIG_TPL_FRAMEWORK=y
CONFIG_TPL_LIBCOMMON_SUPPORT=y
CONFIG_TPL_LIBGENERIC_SUPPORT=y
CONFIG_TPL_CRC32=y
CONFIG_TPL_LEGACY_IMAGE_FORMAT=y
CONFIG_TPL_YMODEM_SUPPORT=y
CONFIG_SYS_TIMER_COUNTS_DOWN=y
CONFIG_DYNAMIC_CRC_TABLE=y
# CONFIG_TPL_USE_ARCH_MEMCPY is not set
# CONFIG_TPL_USE_ARCH_MEMSET is not set
# CONFIG_TPL_SYS_MALLOC_F is not set
CONFIG_SPL_SKIP_LOWLEVEL_INIT=y
CONFIG_SPL_FRAMEWORK=y
CONFIG_SPL_LIBCOMMON_SUPPORT=y
CONFIG_SPL_LIBGENERIC_SUPPORT=y
CONFIG_SPL_DM=y
CONFIG_SPL_OF_CONTROL=y
CONFIG_SPL_SERIAL=y
CONFIG_SPL_DM_SERIAL=y
CONFIG_SPL_CLK=y
CONFIG_SPL_TIMER=y
CONFIG_SPL_SPI=y
CONFIG_SPL_DM_SPI=y
CONFIG_SPL_SPI_FLASH_SUPPORT=y
CONFIG_SPL_DM_SPI_FLASH=y
CONFIG_SPL_SPI_FLASH_TINY=y
CONFIG_SPL_SPI_LOAD=y
CONFIG_SYS_SPI_U_BOOT_OFFS=0xa000
CONFIG_SPL_YMODEM_SUPPORT=y
CONFIG_SPL_LZMA=y
CONFIG_SPL_LZMA_SIZE_OPTIMIZATION=y
CONFIG_SPL_LEGACY_IMAGE_FORMAT=y
CONFIG_SPL_LEGACY_IMAGE_CRC_CHECK=y
# CONFIG_SPL_RAW_IMAGE_SUPPORT is not set
# CONFIG_SPL_USE_ARCH_MEMCPY is not set
# CONFIG_SPL_USE_ARCH_MEMSET is not set
# CONFIG_SPL_WATCHDOG is not set
# CONFIG_SPL_WDT is not set
# CONFIG_SPL_SYSRESET is not set
CONFIG_LTO=y
CONFIG_TEXT_BASE=0x40010000
CONFIG_SPL_TEXT_BASE=0x40100000
CONFIG_SPL_MAX_SIZE=0x7fc0
CONFIG_SPL_SIZE_LIMIT=0x7fc0
# CONFIG_SPL_SHARES_INIT_SP_ADDR is not set
CONFIG_SPL_HAVE_INIT_STACK=y
CONFIG_SPL_STACK=0x40300000
# CONFIG_SPL_SEPARATE_BSS is not set
CONFIG_SPL_BSS_MAX_SIZE=0x1000
CONFIG_SPL_SYS_MALLOC_F_LEN=0x40000
CONFIG_CUSTOM_SYS_INIT_SP_ADDR=0x40f00000
CONFIG_HAS_CUSTOM_SYS_INIT_SP_ADDR=y
CONFIG_SYS_MALLOC_LEN=0x100000
CONFIG_SYS_MALLOC_F_LEN=0x4000
CONFIG_SPL_SYS_MALLOC_SIMPLE=y
CONFIG_STACK_SIZE=0x40000
CONFIG_NR_DRAM_BANKS=1
CONFIG_DEFAULT_DEVICE_TREE="gc1601-tplink-xz000-g7"
CONFIG_SYS_LOAD_ADDR=0x41000000
# CONFIG_SYS_ICACHE_OFF is not set
CONFIG_SPL_SYS_DCACHE_OFF=y
CONFIG_SYS_ARM_CACHE_CP15=y
CONFIG_SYS_ARM_MMU=y
# CONFIG_SYS_THUMB_BUILD is not set
CONFIG_SPL_SYS_THUMB_BUILD=y
CONFIG_BOOTDELAY=3
CONFIG_SYS_CBSIZE=512
CONFIG_SYS_PBSIZE=544
CONFIG_MISC_INIT_R=y
CONFIG_OF_BOARD_SETUP=y
CONFIG_ENV_IS_NOWHERE=y
CONFIG_ENV_SIZE=0x2000
# CONFIG_CMD_SAVEENV is not set
# CONFIG_CMD_IMPORTENV is not set
# CONFIG_CMD_EXPORTENV is not set
# CONFIG_ENV_VARS_UBOOT_RUNTIME_CONFIG is not set
CONFIG_CMD_BDI=y
CONFIG_CMD_CRC32=y
CONFIG_CMD_BOOTZ=y
CONFIG_CMD_FDT=y
CONFIG_CMD_SF=y
CONFIG_CMD_PING=y
CONFIG_CMD_SLEEP=y
CONFIG_CMD_TIME=y
CONFIG_CMD_TFTPPUT=y
CONFIG_CMD_MEMORY=y
# CONFIG_CMD_MEMTEST is not set
# CONFIG_CMD_FLASH is not set
# CONFIG_CMD_FPGA is not set
# CONFIG_CMD_NFS is not set
# CONFIG_CMD_SOURCE is not set
CONFIG_CMD_SETEXPR=y
# CONFIG_CMD_BOOTEFI is not set
# CONFIG_BOOTSTD is not set
# CONFIG_EFI_LOADER is not set
CONFIG_CMD_BOOTM=y
# CONFIG_FIT is not set
# CONFIG_GZIP is not set
# CONFIG_VIDEO is not set
# CONFIG_USB is not set
# CONFIG_MMC is not set
# CONFIG_SCSI is not set
# CONFIG_NET_RANDOM_ETHADDR is not set
CONFIG_NET=y
CONFIG_NETDEVICES=y
CONFIG_DM_ETH=y
CONFIG_DM_MDIO=y
CONFIG_DM_ETH_PHY=y
CONFIG_PHYLIB=y
CONFIG_PHY_GIGE=y
CONFIG_GC1601_ETH=y
CONFIG_GC1601_MDIO=y
CONFIG_MTD=y
CONFIG_SPI_FLASH=y
CONFIG_SPI=y
CONFIG_DM_SPI=y
CONFIG_SPI_MEM=y
CONFIG_FTSPI020_SPI=y
CONFIG_DM_SPI_FLASH=y
CONFIG_SPI_FLASH_EON=y
# CONFIG_SPI_FLASH_SFDP_SUPPORT is not set
# CONFIG_SPI_FLASH_SMART_HWCAPS is not set
CONFIG_CLK=y
CONFIG_TIMER=y
CONFIG_FTTMR010_TIMER=y
CONFIG_WDT=y
CONFIG_WDT_FTWDT010=y
# CONFIG_WATCHDOG is not set
# CONFIG_WATCHDOG_AUTOSTART is not set
CONFIG_SYS_CLK_FREQ=133333333
CONFIG_SYSRESET=y
CONFIG_SYSRESET_WATCHDOG=y
CONFIG_DM_SERIAL=y
CONFIG_SERIAL_RX_BUFFER=y
CONFIG_SERIAL_RX_BUFFER_SIZE=1024
CONFIG_SYS_NS16550=y
CONFIG_SYS_NS16550_MEM32=y
CONFIG_BAUDRATE=115200
CONFIG_OF_SEPARATE=y
CONFIG_LMB=y
CONFIG_USE_PRIVATE_LIBGCC=y
# CONFIG_LOCALVERSION_AUTO is not set
# CONFIG_DISTRO_DEFAULTS is not set
CONFIG_DISPLAY_CPUINFO=y
# CONFIG_CMD_ELF is not set
# CONFIG_BOOTM_NETBSD is not set
# CONFIG_BOOTM_OPENRTOS is not set
# CONFIG_BOOTM_OSE is not set
# CONFIG_BOOTM_PLAN9 is not set
# CONFIG_BOOTM_RTEMS is not set
# CONFIG_BOOTM_VXWORKS is not set
# CONFIG_BOOTM_QNX is not set
CONFIG_CMD_LOADB=y
CONFIG_CMD_LOADXY_TIMEOUT=30
# CONFIG_SPI_FLASH_UNLOCK_ALL is not set
# CONFIG_SPI_FLASH_LOCK is not set
CONFIG_SPI_FLASH_USE_4K_SECTORS=y
CONFIG_SF_DEFAULT_SPEED=100000000
# CONFIG_CMD_LOADS is not set
CONFIG_NET_RETRY_COUNT=5
CONFIG_TFTP_BLOCKSIZE=1468
CONFIG_TFTP_WINDOWSIZE=1
```

## package/boot/uboot-galachip/files/configs/tplink_xz000_g7_ram_defconfig
```kconfig
#include <configs/tplink_xz000_g7_defconfig>

CONFIG_TEXT_BASE=0x41000000
CONFIG_BOOTDELAY=-1
# CONFIG_SPL is not set
# CONFIG_TPL is not set
```

## target/linux/galachip/files/Documentation/devicetree/bindings/clock/galachip,gc1601-scu.yaml
```yaml
# SPDX-License-Identifier: (GPL-2.0-only OR BSD-2-Clause)
%YAML 1.2
---
$id: http://devicetree.org/schemas/clock/galachip,gc1601-scu.yaml#
$schema: http://devicetree.org/meta-schemas/core.yaml#

title: GalaChip GC1601 system control unit clocks

maintainers:
  - Ifran Ali <khanu.i.i.k.2000@gmail.com>

description:
  The boot loader programs PLL0 from the oscillator. Its three outputs, the PLL
  divided by 3, 4 and 5, feed the CPU, the AHB and APB buses and the SPI
  controller. The multiplier of the PLL and the dividers of the CPU and the
  buses are read from the SCU. The clock of the SPI controller can be switched
  between PLL output 2 divided by 8 and divided by 2. The node is also a
  syscon, so that other drivers can reach the registers of the SCU.

properties:
  compatible:
    items:
      - const: galachip,gc1601-scu
      - const: syscon

  reg:
    maxItems: 1

  '#clock-cells':
    const: 1
    description: Clock IDs are in include/dt-bindings/clock/galachip,gc1601-clock.h.

  clocks:
    maxItems: 1

  clock-names:
    items:
      - const: osc

required:
  - compatible
  - reg
  - '#clock-cells'
  - clocks
  - clock-names

additionalProperties: false

examples:
  - |
    clock-controller@90a00000 {
        compatible = "galachip,gc1601-scu", "syscon";
        reg = <0x90a00000 0x20000>;
        #clock-cells = <1>;
        clocks = <&osc>;
        clock-names = "osc";
    };
```

## target/linux/galachip/files/Documentation/devicetree/bindings/i2c/faraday,ftiic010.yaml
```yaml
# SPDX-License-Identifier: (GPL-2.0-only OR BSD-2-Clause)
%YAML 1.2
---
$id: http://devicetree.org/schemas/i2c/faraday,ftiic010.yaml#
$schema: http://devicetree.org/meta-schemas/core.yaml#

title: Faraday FTIIC010 I2C controller

maintainers:
  - Ifran Ali <khanu.i.i.k.2000@gmail.com>

description:
  I2C master that moves one byte at a time through a data register. SCL is
  derived from the input clock by a divider computed from clock-frequency.

allOf:
  - $ref: /schemas/i2c/i2c-controller.yaml#

properties:
  compatible:
    const: faraday,ftiic010

  reg:
    maxItems: 1

  interrupts:
    maxItems: 1

  clocks:
    maxItems: 1

  clock-frequency:
    default: 100000

required:
  - compatible
  - reg
  - clocks

unevaluatedProperties: false

examples:
  - |
    i2c@90600000 {
        compatible = "faraday,ftiic010";
        reg = <0x90600000 0x1000>;
        clocks = <&scu 5>;
        clock-frequency = <100000>;
        #address-cells = <1>;
        #size-cells = <0>;

        eeprom@50 {
            compatible = "atmel,24c02";
            reg = <0x50>;
            read-only;
        };
    };
```

## target/linux/galachip/files/Documentation/devicetree/bindings/interrupt-controller/galachip,gc1601-intc.yaml
```yaml
# SPDX-License-Identifier: (GPL-2.0-only OR BSD-2-Clause)
%YAML 1.2
---
$id: http://devicetree.org/schemas/interrupt-controller/galachip,gc1601-intc.yaml#
$schema: http://devicetree.org/meta-schemas/core.yaml#

title: GalaChip GC1601 interrupt controller (Faraday FTINTC030)

maintainers:
  - Ifran Ali <khanu.i.i.k.2000@gmail.com>

description:
  A Faraday FTINTC030, laid out like a GIC distributor and CPU interface.
  The GC1601 variant has one target byte per shared peripheral interrupt.

properties:
  compatible:
    const: galachip,gc1601-intc

  reg:
    maxItems: 1

  interrupt-controller: true

  '#interrupt-cells':
    const: 2

  '#address-cells':
    const: 0

  faraday,cpu-match-id:
    $ref: /schemas/types.yaml#/definitions/uint32
    description:
      Value written to the CPU match register of the CPU interface, which
      selects the interrupts targeted at this CPU.

required:
  - compatible
  - reg
  - interrupt-controller
  - '#interrupt-cells'
  - faraday,cpu-match-id

additionalProperties: false

examples:
  - |
    interrupt-controller@96000000 {
        compatible = "galachip,gc1601-intc";
        reg = <0x96000000 0x1000>;
        interrupt-controller;
        #interrupt-cells = <2>;
        #address-cells = <0>;
        faraday,cpu-match-id = <1>;
    };
```

## target/linux/galachip/files/Documentation/devicetree/bindings/net/dsa/galachip,gc1601-switch.yaml
```yaml
# SPDX-License-Identifier: (GPL-2.0-only OR BSD-2-Clause)
%YAML 1.2
---
$id: http://devicetree.org/schemas/net/dsa/galachip,gc1601-switch.yaml#
$schema: http://devicetree.org/meta-schemas/core.yaml#

title: GalaChip GC1601 switch

maintainers:
  - Ifran Ali <khanu.i.i.k.2000@gmail.com>

description:
  The switch inside the packet engine of the GalaChip GC1601. Port 0 is the
  PON MAC, port 1 the Gigabit Ethernet UNI and port 2 the CPU port, whose
  conduit is the packet engine.

allOf:
  - $ref: dsa.yaml#/$defs/ethernet-ports

properties:
  compatible:
    const: galachip,gc1601-switch

  reg:
    maxItems: 1

required:
  - compatible
  - reg

unevaluatedProperties: false

examples:
  - |
    switch@90f80000 {
        compatible = "galachip,gc1601-switch";
        reg = <0x90f80000 0x20000>;

        ports {
            #address-cells = <1>;
            #size-cells = <0>;

            port@1 {
                reg = <1>;
                label = "lan1";
                phy-handle = <&phy24>;
                phy-mode = "sgmii";
            };

            port@2 {
                reg = <2>;
                ethernet = <&packet_engine>;
                phy-mode = "internal";

                fixed-link {
                    speed = <1000>;
                    full-duplex;
                };
            };
        };
    };
```

## target/linux/galachip/files/Documentation/devicetree/bindings/net/galachip,gc1601-pon.yaml
```yaml
# SPDX-License-Identifier: (GPL-2.0-only OR BSD-2-Clause)
%YAML 1.2
---
$id: http://devicetree.org/schemas/net/galachip,gc1601-pon.yaml#
$schema: http://devicetree.org/meta-schemas/core.yaml#

title: GalaChip GC1601 GPON/EPON MAC

maintainers:
  - Ifran Ali <khanu.i.i.k.2000@gmail.com>

description:
  The PON MAC of the GalaChip GC1601 ONU SoC. It runs either the ITU-T
  G.984 GPON transmission convergence layer or the IEEE 802.3ah EPON MAC,
  through the PON SerDes, towards a BOSA optical module on I2C. Its frames
  reach the CPU through the packet engine's PON switch port.

properties:
  compatible:
    const: galachip,gc1601-pon

  reg:
    minItems: 4
    items:
      - description: GPON MAC
      - description: optical transmitter power control
      - description: WAN top-level clocks and enables
      - description: global WAN mode configuration
      - description: EPON MAC

  reg-names:
    minItems: 4
    items:
      - const: mac
      - const: txpwr
      - const: top
      - const: global
      - const: emac

  galachip,scu:
    $ref: /schemas/types.yaml#/definitions/phandle
    description: The system control unit, which holds the PON PLL and resets.

  phys:
    maxItems: 1

  phy-names:
    const: serdes

  galachip,bosa-i2c:
    $ref: /schemas/types.yaml#/definitions/phandle
    description:
      The I2C bus of the BOSA. Its SFF-8472 registers lose their contents
      at power-off; the driver programs them from the calibration cell at
      every boot.

  galachip,switch-port:
    $ref: /schemas/types.yaml#/definitions/phandle
    description: The packet engine's switch port that carries the PON traffic.

  omci-uni-ports:
    $ref: /schemas/types.yaml#/definitions/phandle-array
    description:
      The user ports the OMCI agent reports to the OLT as UNIs, in order.

  nvmem-cells:
    minItems: 1
    items:
      - description: The ONU MAC address, the EPON LLID 0 default.
      - description: The BOSA calibration, as programmed at the factory.

  nvmem-cell-names:
    minItems: 1
    items:
      - const: mac-address
      - const: bosa-calibration

  leds:
    $ref: /schemas/types.yaml#/definitions/phandle-array
    maxItems: 2

  led-names:
    maxItems: 2
    items:
      enum: [ pon, los ]

required:
  - compatible
  - reg
  - reg-names
  - galachip,scu
  - phys
  - phy-names
  - galachip,switch-port

additionalProperties: false

examples:
  - |
    pon@90cc0000 {
        compatible = "galachip,gc1601-pon";
        reg = <0x90cc0000 0x24000>, <0x90c40020 0x4>,
              <0x90c00000 0x10>, <0x90c40000 0x20>,
              <0x90c80000 0x2000>;
        reg-names = "mac", "txpwr", "top", "global", "emac";
        galachip,scu = <&scu>;
        phys = <&pon_serdes>;
        phy-names = "serdes";
        galachip,bosa-i2c = <&i2c0>;
        galachip,switch-port = <&switch_pon>;
        omci-uni-ports = <&switch_lan>;
        nvmem-cells = <&macaddr_misc>, <&bosa_calibration>;
        nvmem-cell-names = "mac-address", "bosa-calibration";
        leds = <&led_pon>, <&led_los>;
        led-names = "pon", "los";
    };
```
