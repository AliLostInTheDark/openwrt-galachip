## target/linux/galachip/files/Documentation/devicetree/bindings/phy/galachip,gc1601-pon-serdes.yaml
```yaml
# SPDX-License-Identifier: (GPL-2.0-only OR BSD-2-Clause)
%YAML 1.2
---
$id: http://devicetree.org/schemas/phy/galachip,gc1601-pon-serdes.yaml#
$schema: http://devicetree.org/meta-schemas/core.yaml#

title: GalaChip GC1601 PON SerDes

maintainers:
  - Ifran Ali <khanu.i.i.k.2000@gmail.com>

description:
  The SerDes between the optical module and the GPON/EPON MAC of the
  GalaChip GC1601. Its PLL and resets are in the system control unit; the
  PON MAC sets it to GPON or EPON.

properties:
  compatible:
    const: galachip,gc1601-pon-serdes

  reg:
    items:
      - description: configuration space
      - description: control registers

  reg-names:
    items:
      - const: config
      - const: ctrl

  galachip,scu:
    $ref: /schemas/types.yaml#/definitions/phandle
    description: The system control unit, which holds the PLL and resets.

  "#phy-cells":
    const: 0

required:
  - compatible
  - reg
  - reg-names
  - galachip,scu
  - "#phy-cells"

additionalProperties: false

examples:
  - |
    phy@91000000 {
        compatible = "galachip,gc1601-pon-serdes";
        reg = <0x91000000 0x300000>, <0x91300000 0x100>;
        reg-names = "config", "ctrl";
        galachip,scu = <&scu>;
        #phy-cells = <0>;
    };
```

## target/linux/galachip/files/Documentation/devicetree/bindings/pinctrl/galachip,gc1601-pinctrl.yaml
```yaml
# SPDX-License-Identifier: (GPL-2.0-only OR BSD-2-Clause)
%YAML 1.2
---
$id: http://devicetree.org/schemas/pinctrl/galachip,gc1601-pinctrl.yaml#
$schema: http://devicetree.org/meta-schemas/core.yaml#

title: GalaChip GC1601 pin controller

maintainers:
  - Ifran Ali <khanu.i.i.k.2000@gmail.com>

description:
  Pin multiplexing controller for the GalaChip GC1601 system control unit,
  routing GPIO 0-15 lines to their pads via the SCU syscon.

properties:
  compatible:
    const: galachip,gc1601-pinctrl

  galachip,scu:
    $ref: /schemas/types.yaml#/definitions/phandle
    description: Phandle to the GC1601 SCU syscon node.

patternProperties:
  '-pins$':
    type: object
    $ref: pinmux-node.yaml#
    unevaluatedProperties: false

    properties:
      pins:
        items:
          enum:
            - gpio0
            - gpio1
            - gpio2
            - gpio3
            - gpio4
            - gpio5
            - gpio6
            - gpio7
            - gpio8
            - gpio9
            - gpio10
            - gpio11
            - gpio12
            - gpio13
            - gpio14
            - gpio15

      function:
        const: gpio

    required:
      - pins
      - function

required:
  - compatible
  - galachip,scu

additionalProperties: false

examples:
  - |
    pinctrl: pinctrl {
        compatible = "galachip,gc1601-pinctrl";
        galachip,scu = <&scu>;

        pinctrl_leds: leds-pins {
            pins = "gpio0", "gpio1", "gpio2", "gpio13";
            function = "gpio";
        };
    };
```

## target/linux/galachip/files/Documentation/devicetree/bindings/soc/galachip/galachip,gc1601-ge-serdes.yaml
```yaml
# SPDX-License-Identifier: (GPL-2.0-only OR BSD-2-Clause)
%YAML 1.2
---
$id: http://devicetree.org/schemas/soc/galachip/galachip,gc1601-ge-serdes.yaml#
$schema: http://devicetree.org/meta-schemas/core.yaml#

title: GalaChip GC1601 gigabit Ethernet SerDes

maintainers:
  - Ifran Ali <khanu.i.i.k.2000@gmail.com>

description:
  The SGMII SerDes between the packet engine and the internal gigabit PHY.
  The packet engine programs its control word at cold start, and the PHY
  driver reads its status word. Both reach it as a syscon.

properties:
  compatible:
    items:
      - const: galachip,gc1601-ge-serdes
      - const: syscon

  reg:
    maxItems: 1

required:
  - compatible
  - reg

additionalProperties: false

examples:
  - |
    syscon@91400000 {
        compatible = "galachip,gc1601-ge-serdes", "syscon";
        reg = <0x91400000 0x10>;
    };
```

## target/linux/galachip/files/Documentation/devicetree/bindings/spi/faraday,ftspi020.yaml
```yaml
# SPDX-License-Identifier: (GPL-2.0-only OR BSD-2-Clause)
%YAML 1.2
---
$id: http://devicetree.org/schemas/spi/faraday,ftspi020.yaml#
$schema: http://devicetree.org/meta-schemas/core.yaml#

title: Faraday FTSPI020 SPI memory controller

maintainers:
  - Ifran Ali <khanu.i.i.k.2000@gmail.com>

description:
  Controller for SPI flash that runs one command at a time and moves the data
  through a FIFO. SCK is the input clock divided by 2, 4, 6 or 8.

allOf:
  - $ref: spi-controller.yaml#

properties:
  compatible:
    const: faraday,ftspi020

  reg:
    maxItems: 1

  interrupts:
    maxItems: 1

  clocks:
    maxItems: 1

  clock-names:
    items:
      - const: spiclk

  resets:
    maxItems: 1

patternProperties:
  "^flash@[0-3]$":
    type: object
    properties:
      galachip,safe-max-frequency:
        $ref: /schemas/types.yaml#/definitions/uint32
        description:
          Frequency in Hz that identification, status, programming and erase
          commands must not exceed. spi-max-frequency then applies only to
          reads of 64 bytes or more. Without this property every command may
          use spi-max-frequency.

required:
  - compatible
  - reg
  - clocks
  - clock-names

unevaluatedProperties: false

examples:
  - |
    spi@a0000000 {
        compatible = "faraday,ftspi020";
        reg = <0xa0000000 0x1000>;
        clocks = <&scu 6>;
        clock-names = "spiclk";
        #address-cells = <1>;
        #size-cells = <0>;

        flash@0 {
            compatible = "jedec,spi-nor";
            reg = <0>;
            spi-max-frequency = <100000000>;
            galachip,safe-max-frequency = <25000000>;
            spi-rx-bus-width = <2>;
        };
    };
```

## target/linux/galachip/files/drivers/phy/galachip/Kconfig
```kconfig
# SPDX-License-Identifier: GPL-2.0-only
config PHY_GC1601_PON
	tristate "GalaChip GC1601 PON SerDes"
	depends on ARCH_GALACHIP || COMPILE_TEST
	depends on OF && HAS_IOMEM
	select GENERIC_PHY
	select MFD_SYSCON
	help
	  Enable the SerDes between the optical module and the GPON/EPON MAC
	  of the GalaChip GC1601. The PON driver sets it to GPON or EPON.
```

## target/linux/galachip/files/drivers/soc/galachip/Kconfig
```kconfig
# SPDX-License-Identifier: GPL-2.0-only
config GC1601_PON
	tristate "GC1601 GPON/EPON MAC and PON SerDes"
	depends on ARCH_GALACHIP || COMPILE_TEST
	depends on OF && HAS_IOMEM && I2C && NVMEM
	select MFD_SYSCON
	depends on GC1601_ETH
	depends on XPON_OMCI
	depends on HWMON || HWMON=n
	help
	  Report PON SerDes, optical and ONU state through sysfs. Bring up
	  the PON SerDes in GPON or EPON mode, initialise the matching MAC
	  with optical RX on, program the BOSA from its calibration in flash,
	  run GPON activation or EPON registration and provide the
	  xPON/OMCI device (pon0). Optical TX stays off until userspace
	  allows it (allow_tx). With hwmon, the BOSA diagnostics are a
	  hwmon device named bosa.

config GC1601_GPON_DIAG
	tristate "GC1601 GPON diagnostics"
	depends on GC1601_PON
	help
	  Log the GPON activation, PLOAMs, OMCI messages, T-CONT, GEM port
	  and service set-up and the switch flows to the kernel log, for
	  bring-up on a new OLT. Read-only; load it only when asked for a
	  report.

config GC1601_EPON_DIAG
	tristate "GC1601 EPON diagnostics"
	depends on GC1601_PON
	help
	  Log EPON MAC registers, registration events and the first
	  downstream and upstream frames to the kernel log, for bring-up on
	  an EPON OLT. Read-only; load it only when asked for a report.
```

## target/linux/galachip/files/net/xpon/Kconfig
```kconfig
# SPDX-License-Identifier: GPL-2.0-only
menuconfig XPON
	tristate "xPON subsystem"
	depends on NET
	help
	  Generic Passive Optical Network subsystem. It provides the common
	  representation used by GPON, EPON and XGS-PON devices, including
	  registration state, optical state, carrier, LEDs, sysfs and Generic
	  Netlink notifications.

if XPON

config XPON_OMCI
	tristate "xPON OMCI transport"
	default y
	help
	  ONU Management and Control Interface transport for GPON and XGS-PON
	  providers: Generic Netlink ownership, session generations, typed
	  hardware requests and the identity/configuration store. The OMCI
	  protocol itself runs in userspace (omcid).

endif # XPON
```
