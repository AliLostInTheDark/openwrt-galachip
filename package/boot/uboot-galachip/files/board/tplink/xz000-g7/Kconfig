## target/linux/zte/files/Documentation/devicetree/bindings/net/zte,zx279125-ethernet.yaml
```yaml
# SPDX-License-Identifier: (GPL-2.0-only OR BSD-2-Clause)
%YAML 1.2
---
$id: http://devicetree.org/schemas/net/zte,zx279125-ethernet.yaml#
$schema: http://devicetree.org/meta-schemas/core.yaml#

title: ZTE Sanechips ZX279125 Ethernet CPU packet engine

maintainers:
  - Ifran Ali <khanu.i.i.k.2000@gmail.com>

description: |
  The shared packet engine owns the UNI management traffic and optical control
  queues. Subscriber forwarding is performed by the hardware bridge. Packet
  buffers and rings must remain outside the Linux allocator, including during
  an adopted bootloader handoff. The interrupt mask is shared with the PON MAC.

allOf:
  - $ref: ethernet-controller.yaml#

properties:
  compatible:
    const: zte,zx279125-ethernet

  reg:
    minItems: 8
    maxItems: 15

  reg-names:
    minItems: 8
    items:
      - const: pp
      - const: bmu
      - const: mailbox
      - const: mac
      - const: dma
      - const: intc
      - const: global
      - const: spa
      - const: cla
      - const: bridge
      - const: sadm
      - const: swglb
      - const: sip
      - const: mac0
      - const: reset
    description: |
      The last seven ranges are only used to initialize the engine from reset;
      some are shared with other blocks and are mapped without being claimed.

  interrupts:
    maxItems: 1

  phy-handle: true

  memory-region:
    minItems: 1
    items:
      - description: |
          The 10 MiB no-map packet pool: buffers at +0, buffer-pointer table at
          +0x800000, auxiliary table at +0x820000, local cursor table at
          +0x840000 and sixteen 64 KiB descriptor rings at +0x900000.
      - description: A no-map region holding a cursor table outside the pool

  zte,bootloader-cursors:
    $ref: /schemas/types.yaml#/definitions/uint32
    description: |
      Physical address of the verified bootloader's CPU-only queue handoff
      table, inside the reserved packet memory. Sixteen pairs of little-endian
      u32 values contain ring bases and consumer indices. This address depends
      on the bootloader build and relocation and must be independently verified
      for another board. The source-built monitor uses pool + 0x840000 and updates
      this property in an external Linux FDT after checking a stopped, idle
      engine. A DTB appended to the kernel cannot receive that runtime fixup.
      Reset-state initialization creates the table itself.

required:
  - compatible
  - reg
  - reg-names
  - interrupts
  - phy-handle
  - memory-region
  - zte,bootloader-cursors

unevaluatedProperties: false
```

## target/linux/zte/files/Documentation/devicetree/bindings/net/zte,zx279125-mdio.yaml
```yaml
# SPDX-License-Identifier: (GPL-2.0-only OR BSD-2-Clause)
%YAML 1.2
---
$id: http://devicetree.org/schemas/net/zte,zx279125-mdio.yaml#
$schema: http://devicetree.org/meta-schemas/core.yaml#

title: ZTE ZX279125 MDIO controller

maintainers:
  - Ifran Ali <khanu.i.i.k.2000@gmail.com>

description:
  Clause 22 MDIO controller for the ZX279125 Ethernet PHY management bus.
  The controller does not initialize the packet engine or optical interface.

allOf:
  - $ref: mdio.yaml#

properties:
  compatible:
    const: zte,zx279125-mdio

  reg:
    maxItems: 1

  clocks:
    maxItems: 1

required:
  - compatible
  - reg
  - clocks

unevaluatedProperties: false

examples:
  - |
    mdio@9a101000 {
        compatible = "zte,zx279125-mdio";
        reg = <0x9a101000 0x1000>;
        clocks = <&mdio_clk>;
        #address-cells = <1>;
        #size-cells = <0>;
    };
```

## target/linux/zte/files/Documentation/devicetree/bindings/net/zte,zx279125-pon.yaml
```yaml
# SPDX-License-Identifier: (GPL-2.0-only OR BSD-2-Clause)
%YAML 1.2
---
$id: http://devicetree.org/schemas/net/zte,zx279125-pon.yaml#
$schema: http://devicetree.org/meta-schemas/core.yaml#

title: ZTE Sanechips ZX279125 GPON/EPON MAC

maintainers:
  - Ifran Ali <khanu.i.i.k.2000@gmail.com>

description: |
  The xPON MAC: GPON framing, PLOAM, GEM ports and ranging, the EPON MPCP
  engine and the line AES engine. The top interrupt controller at "intc" is
  shared with the Ethernet packet engine.

properties:
  compatible:
    const: zte,zx279125-pon

  reg:
    maxItems: 10

  reg-names:
    items:
      - const: intc
      - const: epon
      - const: gpon
      - const: rx
      - const: drs
      - const: ports
      - const: gem
      - const: onu
      - const: tx
      - const: aes

  interrupts:
    maxItems: 1

  clocks:
    maxItems: 1

  zte,bosa-i2c:
    $ref: /schemas/types.yaml#/definitions/phandle
    description:
      I2C bus of the optical transceiver's diagnostic interface (address 0x51).

required:
  - compatible
  - reg
  - reg-names
  - interrupts
  - clocks

additionalProperties: false

examples:
  - |
    #include <dt-bindings/clock/zte,zx279125-clock.h>
    #include <dt-bindings/interrupt-controller/arm-gic.h>

    pon@92040000 {
        compatible = "zte,zx279125-pon";
        reg = <0x92040000 0x100>, <0x92080000 0x1000>, <0x920c0000 0x1000>,
              <0x920c4000 0x1000>, <0x920c8000 0x1000>, <0x920cc000 0x4000>,
              <0x920d0000 0x1000>, <0x920d4000 0x1000>, <0x920d8000 0x1000>,
              <0x92100000 0x1000>;
        reg-names = "intc", "epon", "gpon", "rx", "drs", "ports", "gem",
                    "onu", "tx", "aes";
        interrupts = <GIC_SPI 30 IRQ_TYPE_LEVEL_HIGH>;
        clocks = <&crm ZX279125_CLK_GMAC>;
        zte,bosa-i2c = <&i2c0>;
    };
```

## target/linux/zte/files/Documentation/devicetree/bindings/serial/zte,zx279125-uart.yaml
```yaml
# SPDX-License-Identifier: (GPL-2.0-only OR BSD-2-Clause)
%YAML 1.2
---
$id: http://devicetree.org/schemas/serial/zte,zx279125-uart.yaml#
$schema: http://devicetree.org/meta-schemas/core.yaml#

title: ZTE Sanechips ZX279125 UART

maintainers:
  - Ifran Ali <khanu.i.i.k.2000@gmail.com>

allOf:
  - $ref: serial.yaml#

properties:
  compatible:
    const: zte,zx279125-uart

  reg:
    maxItems: 1

  interrupts:
    maxItems: 1

  clocks:
    maxItems: 1

required:
  - compatible
  - reg
  - interrupts
  - clocks

unevaluatedProperties: false

examples:
  - |
    #include <dt-bindings/clock/zte,zx279125-clock.h>
    #include <dt-bindings/interrupt-controller/arm-gic.h>

    serial@94405000 {
        compatible = "zte,zx279125-uart";
        reg = <0x94405000 0x1000>;
        interrupts = <GIC_SPI 11 IRQ_TYPE_LEVEL_HIGH>;
        clocks = <&crm ZX279125_CLK_UART0>;
    };
```

## target/linux/zte/files/Documentation/devicetree/bindings/spi/zte,zx279125-spifc.yaml
```yaml
# SPDX-License-Identifier: (GPL-2.0-only OR BSD-2-Clause)
%YAML 1.2
---
$id: http://devicetree.org/schemas/spi/zte,zx279125-spifc.yaml#
$schema: http://devicetree.org/meta-schemas/core.yaml#

title: ZTE Sanechips ZX279125 SPI flash controller

maintainers:
  - Ifran Ali <khanu.i.i.k.2000@gmail.com>

allOf:
  - $ref: spi-controller.yaml#

properties:
  compatible:
    const: zte,zx279125-spifc

  reg:
    maxItems: 1

  interrupts:
    maxItems: 1

  clocks:
    maxItems: 1

required:
  - compatible
  - reg
  - clocks

unevaluatedProperties: false

examples:
  - |
    #include <dt-bindings/clock/zte,zx279125-clock.h>
    #include <dt-bindings/interrupt-controller/arm-gic.h>

    spi@94407000 {
        compatible = "zte,zx279125-spifc";
        reg = <0x94407000 0x1000>;
        interrupts = <GIC_SPI 9 IRQ_TYPE_LEVEL_HIGH>;
        clocks = <&crm ZX279125_CLK_SPIFC>;
        #address-cells = <1>;
        #size-cells = <0>;

        flash@0 {
            compatible = "jedec,spi-nor";
            reg = <0>;
            spi-max-frequency = <25000000>;
        };
    };
```

## target/linux/zte/files/Documentation/devicetree/bindings/timer/zte,zx279125-timer.yaml
```yaml
# SPDX-License-Identifier: (GPL-2.0-only OR BSD-2-Clause)
%YAML 1.2
---
$id: http://devicetree.org/schemas/timer/zte,zx279125-timer.yaml#
$schema: http://devicetree.org/meta-schemas/core.yaml#

title: ZTE Sanechips ZX279125 timers

maintainers:
  - Ifran Ali <khanu.i.i.k.2000@gmail.com>

description:
  Two 32-bit down-counters, one used for clock events and one as the
  free-running clocksource.

properties:
  compatible:
    const: zte,zx279125-timer

  reg:
    maxItems: 2

  reg-names:
    items:
      - const: event
      - const: source

  interrupts:
    maxItems: 1

  clocks:
    maxItems: 2

  clock-names:
    items:
      - const: event
      - const: source

required:
  - compatible
  - reg
  - reg-names
  - interrupts
  - clocks
  - clock-names

additionalProperties: false

examples:
  - |
    #include <dt-bindings/clock/zte,zx279125-clock.h>
    #include <dt-bindings/interrupt-controller/arm-gic.h>

    timer@94401000 {
        compatible = "zte,zx279125-timer";
        reg = <0x94401000 0x100>, <0x94402000 0x100>;
        reg-names = "event", "source";
        interrupts = <GIC_SPI 17 IRQ_TYPE_EDGE_RISING>;
        clocks = <&crm ZX279125_CLK_TIMER0>, <&crm ZX279125_CLK_TIMER1>;
        clock-names = "event", "source";
    };
```

## target/linux/zte/files/drivers/soc/zte/Kconfig
```kconfig
# SPDX-License-Identifier: GPL-2.0-only

config ZX279125_PON
	tristate "ZTE Sanechips ZX279125 GPON MAC and Optical Controller"
	depends on ARCH_ZX || COMPILE_TEST
	depends on OF && HAS_IOMEM && I2C
	depends on XPON
	depends on XPON_OMCI
	select ZX279125_PP
	select ZX279125_TAGPARAM
	default ARCH_ZX
	help
	  Driver for the integrated ITU-T G.984 GPON MAC and UX3320S/GN25L95
	  optical burst transceiver controller on the ZTE Sanechips ZX279125
	  SoC (VSOL V2801SG). Provides the Linux xPON network device (pon0)
	  and manages ONU states O1 through O7.

config ZX279125_PP
	bool "ZTE Sanechips ZX279125 CPU packet transport"
	depends on NET
	help
	  Shared packet transport between the LAN packet processor driver and
	  the xPON control plane. Subscriber traffic uses the hardware bridge.

config ZX279125_TAGPARAM
	bool
	depends on MTD=y
```
