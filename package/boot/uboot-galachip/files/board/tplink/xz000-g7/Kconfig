## target/linux/realtek-luna/files-6.18/drivers/net/ethernet/realtek/Kconfig
```kconfig
# SPDX-License-Identifier: GPL-2.0-only
#
# Realtek device configuration
#
#
# OpenWrt/realtek-luna -- WHOLE-FILE OVERLAY, migrated out of a patch.
#
# This is Linux 6.18.31's own file plus the realtek-luna GPON/ETH wiring
# that used to live in patches-6.18/103-realtek-luna-gpon.patch.  The patch
# and this file are mutually exclusive: files- overlays are copied into the
# kernel tree BEFORE patches are applied (include/quilt.mk:93-107), so with
# both present patch 103 applies to this file, its context no longer matches
# and the build FAILS LOUDLY.  That is the intended direction -- but it means
# patch 103 must be deleted in the SAME commit that adds this file.
#
# WHY the migration is a prerequisite and not a cleanup: the shared GPON
# core (target/linux/gpon-common) is reached by `select GPON_CORE` from the
# vendor Kconfig, and every later move changes luna's obj-y lines.  Both
# edits land in files that only existed inside a forbidden patch.
# Operator hard rule: driver wiring is a browsable source file, never a
# patches-<ver>/*.patch -- not even for Kconfig/Makefile.
#
# Content is byte-identical to what patch 103 produced (verified 2026-08-05
# against build_dir/target-mips_mips32_musl/.../linux-6.18.31),
# plus `select GPON_CORE` on the two GPON symbols.  Nothing else changed.
#

config NET_VENDOR_REALTEK
	bool "Realtek devices"
	default y
	depends on PCI || (PARPORT && X86) || REALTEK_LUNA
	help
	  If you have a network (Ethernet) card belonging to this class, say Y.

	  Note that the answer to this question doesn't directly affect the
	  kernel: saying N will just cause the configurator to skip all
	  the questions about Realtek devices. If you say Y, you will be asked for
	  your specific card in the following questions.

config LUNA_ETH_MIB
	tristate

config RTL9602C_ETH
	tristate "Realtek RTL9602C (Luna) GMAC + switch"
	depends on REALTEK_LUNA
	select LUNA_ETH_MIB
	default y
	help
	  Clean-room driver for the RTL9602C GMAC + on-chip switch core.

config RTL9602C_FLOWOFFLOAD
	bool "Realtek RTL9602C (Luna) hardware flow offload"
	depends on RTL9602C_ETH
	default y
	select GPON_FLOW_OFFLOAD	# the COMMON TC lifecycle, drivers/net/gpon/
	help
	  Drive the Luna L34/TC flow engine as an nf_flow_table hardware
	  offload backend, through the shared lifecycle in drivers/net/gpon/.

	  This symbol exists so the accelerator can be turned OFF (2026-09-08).
	  RTL9602C_ETH used to select the core itself, which welded the two
	  together: the Luna boards could not be built without the offload, so
	  the offload-vs-AQM comparison -- an operator decision taken with
	  NUMBERS -- had no second state to measure on this family. Cortina had
	  a prompted symbol and Luna had none; now both do.

	  Say Y unless you are measuring the software path deliberately.

config LUNA_GPON
	tristate "Realtek Luna GPON MAC"
	depends on REALTEK_LUNA
	select GPON_CORE	# shared core: drivers/net/gpon/Kconfig
	default y
	help
	  Clean-room GPON MAC foundation driver for the Luna family. Maps the
	  GPON MAC register block (SWCORE + 0x700000) and exposes /proc/gpon.

	  It gates the family-tier luna_gpon.o and luna_ponmac.o plus their
	  flowcore logic halves, for BOTH subtargets (taroko and interaptiv).

config LUNA_ETH
	tristate "Realtek Luna (interAptiv) GMAC + switch"
	depends on REALTEK_LUNA
	select LUNA_ETH_MIB
	default y
	help
	  Clean-room driver for the Luna GMAC0 CPU port plus the on-chip switch
	  core (eth0 over an interAptiv SoC). One driver, a per-chip TABLE:
	  RTL9607C (11 switch ports, 3 CPU GMACs, SerDes uplink) and RTL9603CVD
	  (6 ports, 1 CPU GMAC, no SerDes). The MAC engine is identical on both;
	  508 of 1361 switch registers move, which is why the table exists and
	  why neither chip may borrow the other's offsets.

config LUNA_FLOWOFFLOAD
	bool "Realtek Luna FLOWBASED hardware flow offload"
	depends on LUNA_ETH
	select GPON_FLOW_OFFLOAD
	default y
	help
	  SRAM IPv4 NAT backend for supported FLOWBASED switch layouts.
	  Unsupported dies and flow shapes keep software forwarding.

config LUNA_DEBUG
	bool "Luna family bring-up diagnostics (boot markers, frame dumps, link diag, PHY survey)"
	default n
	help
	  Also the platform's early boot markers ([P] [M] [L] [T] [I] [i]) and its
	  LUNA-DIAG CPU / CM lines, on every Luna board (2026-09-29).
	  The FAMILY member of the per-category debug set (operator, 2026-09-22:
	  "DEBUG por categoria ... para evitar sobrecargar el firmware"). It
	  compiles in the bring-up aids of luna_eth.c: the first-N RX/TX frame
	  hex dumps, the periodic per-port link/rxpkts diagnostic and the PHY
	  survey with its `resurvey` knob; and rtl9602c_eth.c's first-N OMCI TX
	  descriptor prints (one with a 120 us busy-wait each, in the MIB-upload
	  window) and its per-frame DHCP-DS RX check. They printed on EVERY boot of a
	  shipping image. Off, their knobs are constants 0 and the code is gone.
	  The capability stays in the source; only this decides whether it is
	  built. MEASURED 2026-09-22 (G24W, gcc 14.3): luna_eth.o 35768 -> 33846
	  bytes of text, 333 -> 317 of data with it off -- about 1.9 KB; 2026-09-30
	  (X111W): rtl9602c_eth.o 55875 -> 55283 bytes of text.

if NET_VENDOR_REALTEK

config ATP
	tristate "AT-LAN-TEC/RealTek pocket adapter support"
	depends on PARPORT && X86
	select CRC32
	help
	  This is a network (Ethernet) device which attaches to your parallel
	  port. Read the file <file:drivers/net/ethernet/realtek/atp.c>
	  if you want to use this.  If you intend to use this driver, you
	  should have said N to the "Parallel printer support", because the two
	  drivers don't like each other.

	  To compile this driver as a module, choose M here: the module
	  will be called atp.

config 8139CP
	tristate "RealTek RTL-8139 C+ PCI Fast Ethernet Adapter support"
	depends on PCI
	select CRC32
	select MII
	help
	  This is a driver for the Fast Ethernet PCI network cards based on
	  the RTL8139C+ chips. If you have one of those, say Y here.

	  To compile this driver as a module, choose M here: the module
	  will be called 8139cp.  This is recommended.

config 8139TOO
	tristate "RealTek RTL-8129/8130/8139 PCI Fast Ethernet Adapter support"
	depends on PCI
	select CRC32
	select MII
	help
	  This is a driver for the Fast Ethernet PCI network cards based on
	  the RTL 8129/8130/8139 chips. If you have one of those, say Y here.

	  To compile this driver as a module, choose M here: the module
	  will be called 8139too.  This is recommended.

config 8139TOO_PIO
	bool "Use PIO instead of MMIO"
	default y
	depends on 8139TOO && !NO_IOPORT_MAP
	help
	  This instructs the driver to use programmed I/O ports (PIO) instead
	  of PCI shared memory (MMIO).  This can possibly solve some problems
	  in case your mainboard has memory consistency issues.  If unsure,
	  say N.

config 8139TOO_TUNE_TWISTER
	bool "Support for uncommon RTL-8139 rev. K (automatic channel equalization)"
	depends on 8139TOO
	help
	  This implements a function which might come in handy in case you
	  are using low quality on long cabling. It is required for RealTek
	  RTL-8139 revision K boards, and totally unused otherwise.  It tries
	  to match the transceiver to the cable characteristics. This is
	  experimental since hardly documented by the manufacturer.
	  If unsure, say Y.

config 8139TOO_8129
	bool "Support for older RTL-8129/8130 boards"
	depends on 8139TOO
	help
	  This enables support for the older and uncommon RTL-8129 and
	  RTL-8130 chips, which support MII via an external transceiver,
	  instead of an internal one.  Disabling this option will save some
	  memory by making the code size smaller.  If unsure, say Y.

config 8139_OLD_RX_RESET
	bool "Use older RX-reset method"
	depends on 8139TOO
	help
	  The 8139too driver was recently updated to contain a more rapid
	  reset sequence, in the face of severe receive errors.  This "new"
	  RX-reset method should be adequate for all boards.  But if you
	  experience problems, you can enable this option to restore the
	  old RX-reset behavior.  If unsure, say N.

config R8169
	tristate "Realtek 8169/8168/8101/8125 ethernet support"
	depends on PCI
	select FW_LOADER
	select CRC32
	select PHYLIB
	select REALTEK_PHY
	help
	  Say Y here if you have a Realtek Ethernet adapter belonging to
	  the following families:
	  RTL8169 Gigabit Ethernet
	  RTL8168 Gigabit Ethernet
	  RTL8101 Fast Ethernet
	  RTL8125 2.5GBit Ethernet

	  To compile this driver as a module, choose M here: the module
	  will be called r8169.  This is recommended.

config R8169_LEDS
	bool "Support for controlling the NIC LEDs"
	depends on R8169 && LEDS_TRIGGER_NETDEV
	depends on !(R8169=y && LEDS_CLASS=m)
	help
	  Optional support for controlling the NIC LED's with the netdev
	  LED trigger.

config RTASE
	tristate "Realtek Automotive Switch 9054/9068/9072/9075/9068/9071 PCIe Interface support"
	depends on PCI
	select CRC32
	select PAGE_POOL
	help
	  Say Y here and it will be compiled and linked with the kernel
	  if you have a Realtek Ethernet adapter belonging to the
	  following families:
	  RTL9054 5GBit Ethernet
	  RTL9068 5GBit Ethernet
	  RTL9072 5GBit Ethernet
	  RTL9075 5GBit Ethernet
	  RTL9068 5GBit Ethernet
	  RTL9071 5GBit Ethernet

	  To compile this driver as a module, choose M here: the module
	  will be called rtase. This is recommended.

endif # NET_VENDOR_REALTEK
```

## target/linux/realtek-luna/files-6.18/drivers/net/wireless/realtek/rtlwifi/rtl8192fe/Kconfig
```kconfig
# SPDX-License-Identifier: GPL-2.0-only
config RTL8192FE
	tristate "Realtek RTL8192FE 802.11n PCIe Wireless Network Adapter"
	depends on PCI
	select RTLWIFI
	select RTLWIFI_PCI
	help
	  Clean-room mac80211 driver for the Realtek RTL8192F (RTL8192FE)
	  802.11n 2T2R PCIe Wi-Fi adapter (PCI 0x10ec:0x818c). Built as an
	  rtlwifi sub-driver; reuses the rtlwifi PCI core. See DESIGN.md.
```

## target/linux/zte/files/Documentation/devicetree/bindings/arm/zte.yaml
```yaml
# SPDX-License-Identifier: (GPL-2.0-only OR BSD-2-Clause)
%YAML 1.2
---
$id: http://devicetree.org/schemas/arm/zte.yaml#
$schema: http://devicetree.org/meta-schemas/core.yaml#

title: ZTE Sanechips platforms

maintainers:
  - Ifran Ali <khanu.i.i.k.2000@gmail.com>

properties:
  $nodename:
    const: /
  compatible:
    oneOf:
      - description: ZX279125 based boards
        items:
          - enum:
              - vsol,v2801sg
          - const: zte,zx279125

additionalProperties: true
```

## target/linux/zte/files/Documentation/devicetree/bindings/clock/zte,zx279125-crm.yaml
```yaml
# SPDX-License-Identifier: (GPL-2.0-only OR BSD-2-Clause)
%YAML 1.2
---
$id: http://devicetree.org/schemas/clock/zte,zx279125-crm.yaml#
$schema: http://devicetree.org/meta-schemas/core.yaml#

title: ZTE Sanechips ZX279125 clock and reset manager

maintainers:
  - Ifran Ali <khanu.i.i.k.2000@gmail.com>

description: |
  The CRM provides the CPU, timer, UART, SPI, I2C, MDIO and network clocks.
  Clock indices are defined in include/dt-bindings/clock/zte,zx279125-clock.h.

properties:
  compatible:
    const: zte,zx279125-crm

  reg:
    maxItems: 3

  reg-names:
    items:
      - const: crm
      - const: peripheral
      - const: network

  clocks:
    maxItems: 1

  clock-names:
    items:
      - const: osc

  '#clock-cells':
    const: 1

required:
  - compatible
  - reg
  - reg-names
  - clocks
  - clock-names
  - '#clock-cells'

additionalProperties: false

examples:
  - |
    clock-controller@94000000 {
        compatible = "zte,zx279125-crm";
        reg = <0x94000000 0x1000>, <0x94400000 0x100>, <0x9a100000 0x100>;
        reg-names = "crm", "peripheral", "network";
        #clock-cells = <1>;
        clocks = <&osc>;
        clock-names = "osc";
    };
```

## target/linux/zte/files/Documentation/devicetree/bindings/gpio/zte,zx279125-gpio.yaml
```yaml
# SPDX-License-Identifier: (GPL-2.0-only OR BSD-2-Clause)
%YAML 1.2
---
$id: http://devicetree.org/schemas/gpio/zte,zx279125-gpio.yaml#
$schema: http://devicetree.org/meta-schemas/core.yaml#

title: ZTE Sanechips ZX279125 GPIO controller

maintainers:
  - Ifran Ali <khanu.i.i.k.2000@gmail.com>

properties:
  compatible:
    const: zte,zx279125-gpio

  reg:
    maxItems: 1

  gpio-controller: true

  '#gpio-cells':
    const: 2

required:
  - compatible
  - reg
  - gpio-controller
  - '#gpio-cells'

additionalProperties: false

examples:
  - |
    gpio@94404000 {
        compatible = "zte,zx279125-gpio";
        reg = <0x94404000 0x1000>;
        gpio-controller;
        #gpio-cells = <2>;
    };
```

## target/linux/zte/files/Documentation/devicetree/bindings/i2c/zte,zx296718-i2c.yaml
```yaml
# SPDX-License-Identifier: (GPL-2.0-only OR BSD-2-Clause)
%YAML 1.2
---
$id: http://devicetree.org/schemas/i2c/zte,zx296718-i2c.yaml#
$schema: http://devicetree.org/meta-schemas/core.yaml#

title: ZTE ZX2967 family I2C controller

maintainers:
  - Ifran Ali <khanu.i.i.k.2000@gmail.com>

allOf:
  - $ref: /schemas/i2c/i2c-controller.yaml#

properties:
  compatible:
    oneOf:
      - const: zte,zx296718-i2c
      - items:
          - const: zte,zx279125-i2c
          - const: zte,zx296718-i2c

  reg:
    maxItems: 1

  interrupts:
    maxItems: 1

  clocks:
    maxItems: 1

  clock-frequency: true

required:
  - compatible
  - reg
  - interrupts
  - clocks

unevaluatedProperties: false

examples:
  - |
    #include <dt-bindings/clock/zte,zx279125-clock.h>
    #include <dt-bindings/interrupt-controller/arm-gic.h>

    i2c@9a102000 {
        compatible = "zte,zx279125-i2c", "zte,zx296718-i2c";
        reg = <0x9a102000 0x1000>;
        interrupts = <GIC_SPI 28 IRQ_TYPE_LEVEL_HIGH>;
        clocks = <&crm ZX279125_CLK_I2C>;
        clock-frequency = <100000>;
        #address-cells = <1>;
        #size-cells = <0>;
    };
```
